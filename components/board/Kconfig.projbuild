## components/board/Kconfig.projbuild
```kconfig
menu "SlateFPV board"

choice SLATE_BOARD
    prompt "Board"
    default SLATE_BOARD_C3_SUPERMINI if IDF_TARGET_ESP32C3
    default SLATE_BOARD_GENERIC
    help
      Which physical board this image is for.

      The chip is necessary and not sufficient. Two boards carrying the same
      part can put the LED on different pins, drive it with opposite polarity,
      or have no LED at all -- so selecting a target is not the same as
      selecting a board, and only the pins below decide what gets driven.

config SLATE_BOARD_C3_SUPERMINI
    bool "ESP32-C3 Supermini"
    depends on IDF_TARGET_ESP32C3
    help
      The board SlateFPV ships and flies on. LED on GPIO8 (inverted), BOOT
      button on GPIO9. Both are strapping pins and nothing else may be wired
      to them.

config SLATE_BOARD_GENERIC
    bool "Other board -- set the pins below"
    help
      Any other board. Nothing is assumed about it: the LED is absent unless
      you give it a pin.

endchoice

config SLATE_LED_GPIO
    int "Status LED GPIO (-1 for none)"
    depends on SLATE_BOARD_GENERIC
    range -1 48
    default -1
    help
      -1 means this board has no LED we can drive, and every LED state becomes
      a no-op.

      That is the default on purpose. Several dev boards -- the S3 DevKitC and
      the C6 DevKitC among them -- put an addressable WS2812 where the C3
      Supermini has a plain LED, and this firmware drives a plain LED only.
      Pointing it at a WS2812's data pin will not light it, and pointing it at
      a pin that carries something else can do worse than nothing.

      Check your board's schematic. A dark LED is a much better failure than a
      pin driven by mistake.

config SLATE_LED_ACTIVE_LOW
    bool "LED lights when the pin is LOW"
    depends on SLATE_BOARD_GENERIC
    default y
    help
      True when the LED sits between 3V3 and the pin, which is the common
      arrangement on dev boards.

config SLATE_BUTTON_GPIO
    int "Button GPIO (-1 for none)"
    depends on SLATE_BOARD_GENERIC
    range -1 48
    default 9 if IDF_TARGET_ESP32C3 || IDF_TARGET_ESP32C6 || IDF_TARGET_ESP32C61 || IDF_TARGET_ESP32C5 || IDF_TARGET_ESP32C2
    default 0
    help
      Defaults to the BOOT button, which nearly every dev board has: GPIO9 on
      the RISC-V parts, GPIO0 on the S3 and the original ESP32.

      Worth having. The button is the recovery gesture -- a ten second hold
      enters setup with no flight controller, no radio and no working camera
      link involved. Set it to -1 only if the board genuinely has no button, in
      which case setup is reachable only from the setup switch or a cable.

config SLATE_BUTTON_ACTIVE_LOW
    bool "Button reads LOW when pressed"
    depends on SLATE_BOARD_GENERIC
    default y
    help
      True for a button to ground with a pull-up, which is what BOOT is.

endmenu
```

## main/Kconfig.projbuild
```kconfig
menu "SlateFPV configuration"

config CAMLINK_BENCH
    bool "Bench console (development only)"
    default n
    help
      DEVELOPMENT ONLY -- leave this off for anything that flies.

      Adds a line protocol on the USB serial port, driven by
      tools/slate-cli.py. Alongside read-only status it accepts commands
      that rebind the module to an arbitrary MAC, drop the camera link,
      clear BLE bonds and change record settings, none of which belong on
      a shipped unit.

        out:  #ST <link> <valid> <rec> <clip_s> <free_mb> <left_s> <batt>
              #FC <link> <armed> <boxarm_known> <bit> <nch> ch0..ch7 <rx> <crc>
        in:   'r' toggle record, '1' start, '0' stop

      Both halves run, so the flight controller can be brought up on its own
      with the camera switched off, and vice versa. Recording only ever changes
      on an explicit keypress.

config CAMLINK_SNIFF
    bool "DIAG: log every BLE advertisement seen while scanning"
    default n
    help
      Bring-up aid. In setup and bind modes, logs every BLE device heard --
      name, address, signal, connectable flag and the raw advert bytes -- so a
      camera the vendor filters do not recognise can be identified from what it
      actually broadcasts. Noisy; leave off for normal use.

config CAMLINK_GPSETTINGS_DUMP
    bool "DIAG: dump every GoPro setting the camera reports"
    default n
    help
      Registers for all GoPro settings and logs each id/value, to find out what
      a camera reports for resolution and framerate. Noisy; off for normal use.

config CAMLINK_USB_CONSOLE
    bool "USB console (command prompt on the USB-C port)"
    default y
    help
      A line-at-a-time prompt on the Supermini's native USB port, sharing it
      with the log: `st` for camera and flight-controller state, `rec` to
      start and stop recording, `scan` for the setup-mode camera list, and a
      few housekeeping commands. Type `help`.

      Reachable only with a cable in the port, which a flying module does not
      have, so it is on by default. It reads the receive FIFO directly and
      never installs the USB driver, so the log's behaviour with no host
      attached is unchanged.

choice CAMLINK_BLE_TX_POWER
    prompt "BLE transmit power"
    default CAMLINK_TX_N24
    help
      -24 dBm is correct in flight: the camera sits ~20 cm away, leaving about
      45 dB of margin, and staying quiet matters next to the ELRS receiver.

      It is a poor bench setting. Connection establishment needs the camera to
      hear us, and across a desk -24 dBm is marginal -- the symptom is a camera
      that is discovered reliably but whose connections time out.

    config CAMLINK_TX_N24
        bool "-24 dBm (flight default, camera ~20 cm)"
    config CAMLINK_TX_N12
        bool "-12 dBm (bench, camera on the same desk)"
    config CAMLINK_TX_N0
        bool "0 dBm (bench, camera across the room)"
    config CAMLINK_TX_P3
        bool "+3 dBm (maximum reach, not for flight)"
endchoice

config CAMLINK_BLE_BONDING
    bool "Bond / encrypt the BLE link to the camera"
    default y
    help
      Just Works bonding plus link encryption before speaking DUML.

      Required, not optional: unencrypted, the camera accepts the connection
      and then terminates it itself with reason 0x13 after about 16 s. Turn off
      only to reproduce the upstream DJI demo's behaviour.

config CAMLINK_BLE_CLEAR_BONDS
    bool "Clear stored BLE bonds at every boot"
    default n
    help
      Bring-up aid. A bond held on one side but forgotten by the other makes
      the next connection fail at link level with reason 0x3e.

      Leave OFF in normal use: once a camera is paired, deleting our half means
      the camera still expects an encrypted link we can no longer establish and
      every reconnect times out. Use the button's long-press re-bind instead,
      which clears both sides together.

config CAMLINK_BLE_SCAN_DEBUG
    bool "Log every BLE advertisement, GATT service and characteristic"
    default n
    help
      Dumps name, RSSI, manufacturer data and the DJI-filter verdict for every
      advertisement, plus the full GATT database and a one-shot read of every
      readable characteristic on connect.

      Diagnostic only -- it adds around a second to every connection. Use it
      when a camera is powered on but never connects: it distinguishes "not
      advertising" from "advertising something we reject", which otherwise look
      identical on the console.

choice CAMLINK_RECORD_MODE
    prompt "Record trigger mode"
    default CAMLINK_MODE_CUT
    config CAMLINK_MODE_ARM
        bool "ARM - arm starts recording, disarm stops"
    config CAMLINK_MODE_SWITCH
        bool "SWITCH - an RC channel controls recording"
    config CAMLINK_MODE_CUT
        bool "CUT - arm records; a press cuts and restarts the clip"

    config CAMLINK_MODE_BOTH
        bool "BOTH - arm records; a press toggles recording independently"
endchoice

config CAMLINK_SWITCH_CHANNEL
    int "RC switch channel (0-based; 6 = AUX3)"
    range 0 17
    default 6
    help
      First-boot default only -- the settings page writes the real value to
      NVS. MSP_RC returns rcData[] with the four sticks first, so AUX n is
      index n+3.

config CAMLINK_SWITCH_THRESHOLD
    int "RC switch window, lower edge (us)"
    range 900 2100
    default 1750
    help
      First-boot default only. The range is 900-2100 because that is what a
      receiver actually produces: CRSF and SBUS both put a switch at +100% on
      about 2012 us, so a limit of 2000 could not contain the very position the
      user was pointing at. See the scale note in camlink_cfg.h.

config CAMLINK_MSP_TX_GPIO
    int "UART1 TX GPIO (to FC RX)"
    default 4
    help
      Avoid GPIO2 and GPIO3. GPIO8 and GPIO9 carry the onboard LED and button
      and must stay free. Leave GPIO20/21 for the console.

config CAMLINK_MSP_RX_GPIO
    int "UART1 RX GPIO (from FC TX)"
    default 5

config CAMLINK_MSP_BAUD
    int "MSP baud rate"
    default 115200

endmenu
```

## sdkconfig.defaults.esp32c3
```kconfig
CONFIG_IDF_TARGET="esp32c3"
CONFIG_BT_ENABLED=y
# CONFIG_BT_BLE_50_FEATURES_SUPPORTED is not set
CONFIG_BT_BLE_42_FEATURES_SUPPORTED=y
```
